## meta-mackerel/conf/distro/mackerel.conf
```bitbake
DISTRO_NAME = "Mackerel (Mackerel Embedded Linux Distro)"
DISTRO_VERSION = "0.1"

PACKAGE_CLASSES ?= "package_rpm"

INIT_MANAGER = "systemd"

IMAGE_LINGUAS = "en-us"
GLIBC_GENERATE_LOCALES = "en_US.UTF-8"

IMAGE_INSTALL:append = " glibc-binary-localedata-en-us openssh tmux vim gdbserver strace lsof curl jq"
```
